## layers/meta-custom-syn/conf/layer.conf
```bitbake
BBPATH .= ":${LAYERDIR}"
BBFILES += "${LAYERDIR}/recipes-*/*/*.bb ${LAYERDIR}/recipes-*/*/*.bbappend"

BBFILE_COLLECTIONS += "meta-custom"
BBFILE_PATTERN_meta-custom = "^${LAYERDIR}/"
BBFILE_PRIORITY_meta-custom = "10"

LAYERDEPENDS_meta-custom = "core openembedded-layer virtualization-layer"
LAYERSERIES_COMPAT_meta-custom = "scarthgap"

COMPATIBLE_MACHINE_meta-custom = "sl1640spi"
```

## layers/meta-custom/conf/layer.conf
```bitbake
BBPATH .= ":${LAYERDIR}"
BBFILES += "${LAYERDIR}/recipes-*/*/*.bb ${LAYERDIR}/recipes-*/*/*.bbappend"

BBFILE_COLLECTIONS += "meta-custom"
BBFILE_PATTERN_meta-custom = "^${LAYERDIR}/"
BBFILE_PRIORITY_meta-custom = "10"

LAYERDEPENDS_meta-custom = "core raspberry openembedded-layer virtualization-layer"
LAYERSERIES_COMPAT_meta-custom = "scarthgap"
```
